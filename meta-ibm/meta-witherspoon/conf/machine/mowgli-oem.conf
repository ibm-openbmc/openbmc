## meta-ibm/meta-witherspoon/conf/machine/mowgli-oem.conf
```bitbake
MACHINEOVERRIDES =. "mowgli:"
require conf/machine/mowgli.conf

KERNEL_DEVICETREE = "${KMACHINE}-bmc-opp-mowgli.dtb"

MRW_XML = "mowgli.xml"
```

## meta-ibm/meta-witherspoon/conf/machine/mowgli.conf
```bitbake
KMACHINE = "aspeed"
KERNEL_DEVICETREE = "${KMACHINE}-bmc-opp-${MACHINE}.dtb"
KERNEL_FEATURES_append = " phosphor-wdt-on-panic"

UBOOT_MACHINE = "ast_g5_ncsi_config"

OBMC_POWER_SUPPLY_INSTANCES = "0 1"

PREFERRED_PROVIDER_virtual/p9-vcs-workaround = ''
PREFERRED_PROVIDER_virtual/openpower-fru-vpd-layout = "mihawk-openpower-fru-vpd-layout-native"

require conf/machine/include/ast2500.inc
require conf/machine/include/obmc-bsp-common.inc
require conf/machine/include/openpower.inc
require conf/machine/include/p9.inc
require conf/distro/include/phosphor-aspeednic-use-mac2.inc

PHOSPHOR_MRW_LICENSE = "Apache-2.0"
PHOSPHOR_MRW_LIC_FILES_CHKSUM = "file://LICENSE;md5=e3fc50a88d0a364313df4b21ef20c29e"
PHOSPHOR_MRW_URI = "git://github.com/ibm-op-release/mowgli-xml"
PHOSPHOR_MRW_REV = "edbf47e969271c738a5e2ac1a0c688a8b056fb21"



# Inhibit phosphor-hwmon-config-mrw
VIRTUAL-RUNTIME_phosphor-hwmon-config_df-mrw = ""

# Inhibit phosphor-fan-presence-mrw-native
PREFERRED_PROVIDER_virtual/phosphor-fan-presence-config_df-mrw = \
    "phosphor-fan-presence-config"

# Inhibit phosphor-fan-control-fan-config-mrw-native
PREFERRED_PROVIDER_virtual/phosphor-fan-control-fan-config_df-mrw = \
    "phosphor-fan-control-fan-config"

# Inhibit mowgli-led-manager-config-native
PREFERRED_PROVIDER_virtual/phosphor-led-manager-config-native_df-mrw = \
    "mowgli-led-manager-config-native"

PREFERRED_PROVIDER_virtual/phosphor-logging-callouts_df-mrw = "mowgli-phosphor-logging-callouts-native"

PREFERRED_PROVIDER_virtual/openpower-fru-inventory_df-mrw = "mihawk-openpower-fru-inventory-native"
```

## meta-ibm/meta-witherspoon/conf/machine/witherspoon-ips.conf
```bitbake
MACHINEOVERRIDES =. "witherspoon:"
require conf/machine/witherspoon.conf

KERNEL_DEVICETREE = "${KMACHINE}-bmc-opp-witherspoon.dtb"

MRW_XML = "witherspoon.xml"
```
